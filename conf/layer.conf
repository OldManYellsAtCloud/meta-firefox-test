## conf/layer.conf
```bitbake
BBPATH .= ":${LAYERDIR}"
BBFILES += "${LAYERDIR}/recipes-*/*/*.bb ${LAYERDIR}/recipes-*/*/*.bbappend"

BBFILE_COLLECTIONS += "firefox-test-layer"
BBFILE_PATTERN_firefox-test-layer := "^${LAYERDIR}/"
BBFILE_PRIORITY_firefox-test-layer = "7"

LAYERVERSION_firefox-test-layer = "1"
LAYERSERIES_COMPAT_firefox-test-layer = "kirkstone scarthgap walnascar whinlatter"

LAYERDEPENDS_firefox-test-layer = "firefox-browser-layer"
```
